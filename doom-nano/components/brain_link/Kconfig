## doom-nano/components/brain_link/Kconfig
```kconfig
menu "doom-esp32 brain link"

    config DOOM_BRAIN_PLAY
        bool "Let the STM32 brain play (start a real game instead of the attract demos)"
        default y
        help
            Starts E1M1 directly and drives the player from the brain's replies. Without the
            brain connected the player stands still. Turn off to get the attract demos back.

    config DOOM_BRAIN_MAP
        int "Episode 1 map to start on (E1M<n>)"
        range 1 9
        default 2
        depends on DOOM_BRAIN_PLAY
        help
            E1M1's start room is empty (its nearest monster is about 1700 map units away), and
            the player only reacts to what is on screen. E1M2 at skill 3 has 11 monsters
            within 1000 units of the start.

    config DOOM_BRAIN_SKILL
        int "Skill level (1 easiest .. 5 hardest)"
        range 1 5
        default 3
        depends on DOOM_BRAIN_PLAY

    config DOOM_BRAIN_LEARN
        bool "Let the brain learn while playing (reward-modulated plasticity on the STM32)"
        default y
        depends on DOOM_BRAIN_PLAY
        help
            Sends BRAIN_STEP_FLAG_LEARN with a reward: +1 per monster the player kills, minus
            health lost / 100. Only while the player is alive in a level. The STM32 keeps the
            learned weights in RAM until it is reset or power cycled. Off: the connectome
            weights (or whatever the STM32 learned before) are used unchanged.

    config DOOM_BRAIN_RESET_WEIGHTS_ON_BOOT
        bool "Return the brain to the connectome weights when the ESP32 boots"
        default n
        depends on DOOM_BRAIN_PLAY
        help
            Sends BRAIN_STEP_FLAG_RESET_WEIGHTS once, with the first STEP after boot. Off: what
            the brain learned survives an ESP32 reboot as long as the STM32 stays powered.

    config DOOM_BRAIN_TX_GPIO
        int "ESP32 TX GPIO (to STM32 PB7 / Nucleo D0)"
        default 17
        help
            GPIO17 and 18 are free on the ESP32-S3 N16R8 (not flash, PSRAM, USB, UART0, strapping
            or the OLED's GPIO8/9).

    config DOOM_BRAIN_RX_GPIO
        int "ESP32 RX GPIO (from STM32 PB6 / Nucleo D1)"
        default 18

    config DOOM_BRAIN_BAUD
        int "Link baud rate"
        default 115200

endmenu
```

## doom-nano/components/doom_platform/Kconfig
```kconfig
menu "doom-esp32 OLED"

    choice DOOM_OLED_STYLE
        prompt "Display style while playing"
        default DOOM_OLED_STYLE_NANO
        help
            How the 3D view is drawn on the 128x64 panel. Title, menus, the automap and screen
            wipes always use the outline style. See NOTES.md for the comparison.

        config DOOM_OLED_STYLE_NANO
            bool "nano: flat shaded walls, black floors, crisp sprites, HUD line"
        config DOOM_OLED_STYLE_LAYERS
            bool "layers: dim scene, bright haloed sprites"
        config DOOM_OLED_STYLE_OUTLINE
            bool "outline: dimmed dither plus edges (no engine masks)"
    endchoice

endmenu
```

## doom-nano/demo/oled_stream/main/Kconfig.projbuild
```kconfig
menu "OLED stream demo"

choice DEMO_TRANSPORT
    prompt "Link to the laptop"
    default DEMO_TRANSPORT_UART
    help
        Which connector carries the binary demo stream. Logs are disabled on that link.

config DEMO_TRANSPORT_UART
    bool "UART0 through the board's USB-UART bridge (COM connector)"

config DEMO_TRANSPORT_USB_JTAG
    bool "Native USB Serial/JTAG (USB connector)"

endchoice

config DEMO_UART_BAUD
    int "UART0 baud rate"
    depends on DEMO_TRANSPORT_UART
    default 2000000
    range 115200 5000000

endmenu
```
